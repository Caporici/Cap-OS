## build/conf/bblayers.conf
```bitbake
# POKY_BBLAYERS_CONF_VERSION is increased each time build/conf/bblayers.conf
# changes incompatibly
POKY_BBLAYERS_CONF_VERSION = "2"

BBPATH = "${TOPDIR}"
BBFILES ?= ""

BBLAYERS ?= " \
  /home/victor/Github/cap-os/meta \
  /home/victor/Github/cap-os/meta-poky \
  /home/victor/Github/cap-os/meta-raspberrypi \
  /home/victor/Github/cap-os/meta-openembedded/meta-oe \
  /home/victor/Github/cap-os/meta-cap-os \
  /home/victor/Github/cap-os/build/workspace \
  "
  
```

## build/conf/local.conf
```bitbake
# -----------------------------------------------------------------------------
# Target Machine and Hardware Configuration
# -----------------------------------------------------------------------------
MACHINE = "raspberrypi4"
DISTRO_NAME = "CAP-OS"
DISTRO_VERSION = "1.0"
hostname:pn-base-files = "CAP-OS"

ENABLE_UART = "1"
ENABLE_SPI_BUS = "1"

# -----------------------------------------------------------------------------
# Kernel and Modules
# -----------------------------------------------------------------------------
IMAGE_INSTALL:append = " kernel-modules"

# -----------------------------------------------------------------------------
# Boot / config.txt Configuration (Display Map)
# -----------------------------------------------------------------------------
RPI_EXTRA_CONFIG = " \n \
dtparam=spi=on \n \
dtoverlay=tft35a,rotate=90,speed=16000000 \n \
hdmi_force_hotplug=1 \
"

RPI_EXTRA_CONFIG:append = " \n \
fbcon=map:1 \n \
"

# -----------------------------------------------------------------------------
# Distribution and Init Manager (Systemd)
# -----------------------------------------------------------------------------
DISTRO ?= "poky"
CONF_VERSION = "2"
DISTRO_FEATURES:append = " systemd usrmerge"
VIRTUAL-RUNTIME_init_manager = "systemd"
VIRTUAL-RUNTIME_initscripts = ""

IMAGE_INSTALL:append = " fbset fbset-modes"

# -----------------------------------------------------------------------------
# Image Features and Build Settings
# -----------------------------------------------------------------------------
EXTRA_IMAGE_FEATURES ?= "debug-tweaks"
IMAGE_FEATURES += " ssh-server-openssh"
USER_CLASSES ?= "buildstats"
PATCHRESOLVE = "noop"
BB_SANDBOX = "0"
IMAGE_FSTYPES += "wic wic.bz2"

# Forces Yocto to copy the custom overlay to the BOOT partition
IMAGE_BOOT_FILES:append = " tft35a.dtbo;overlays/tft35a.dtbo"

# -----------------------------------------------------------------------------
# Disk Space Monitoring
# -----------------------------------------------------------------------------
BB_DISKMON_DIRS ??= "\
    STOPTASKS,${TMPDIR},1G,100K \
    STOPTASKS,${DL_DIR},1G,100K \
    STOPTASKS,${SSTATE_DIR},1G,100K \
    STOPTASKS,/tmp,100M,100K \
    HALT,${TMPDIR},100M,1K \
    HALT,${DL_DIR},100M,1K \
    HALT,${SSTATE_DIR},100M,1K \
    HALT,/tmp,10M,1K \
"

# Create a script to map console to TFT (fb1) during boot
#IMAGE_POSTPROCESS_COMMAND:append = " echo 'con2fbmap 1 1' > ${IMAGE_ROOTFS}/etc/profile.d/tft-init.sh; "
```

## meta-cap-os/conf/layer.conf
```bitbake
# We have a conf and classes directory, add to BBPATH
BBPATH .= ":${LAYERDIR}"

# We have recipes-* directories, add to BBFILES
BBFILES += "${LAYERDIR}/recipes-*/*/*.bb \
            ${LAYERDIR}/recipes-*/*/*.bbappend"

BBFILE_COLLECTIONS += "meta-cap-os"
BBFILE_PATTERN_meta-cap-os = "^${LAYERDIR}/"
BBFILE_PRIORITY_meta-cap-os = "6"

LAYERDEPENDS_meta-cap-os = "core"
LAYERSERIES_COMPAT_meta-cap-os = "scarthgap"
```
